## techpack/data/drivers/Kconfig
```kconfig
menu "Qualcomm RmNet extensions"

source "techpack/data/drivers/emac-dwc-eqos/Kconfig"
source "techpack/data/drivers/rmnet/Kconfig"

endmenu
```

## techpack/data/drivers/emac-dwc-eqos/Kconfig
```kconfig
#
# Synopsis EMAC device configuration
#

config EMAC_DWC_EQOS
	tristate "Qualcomm Technologies Inc. EMAC support"
	depends on (ARM || ARM64)
	default n
	help
	  This driver supports the Synopsis EMAC Gigabit
	  Ethernet controller.
```
